## apps/amh/Kconfig
```kconfig
config EXAMPLES_AMH
	bool "AMH-OS command suite"
	default y
	depends on NSH_LIBRARY
	---help---
		Build the AMH-OS user-space command suite. Available at the NSH prompt:
		  nsh> amh help

config EXAMPLES_AMH_PROGNAME
	string "AMH-OS program name"
	default "amh"
	depends on EXAMPLES_AMH

config EXAMPLES_AMH_PRIORITY
	int "AMH-OS task priority"
	default 100
	depends on EXAMPLES_AMH

config EXAMPLES_AMH_STACKSIZE
	int "AMH-OS task stack size"
	default 4096
	depends on EXAMPLES_AMH
```

## native/esp-idf-v3/main/Kconfig.projbuild
```kconfig
menu "AMH-OS configuration"

config AMH_ENABLE_WEB_DESKTOP
    bool "Enable Wi-Fi AP and HTTP desktop"
    default n
    help
        Enables the development Wi-Fi access point and HTTP desktop.
        Disabled by default so the kernel boots through the UART console
        without starting network services.

endmenu
```

## native/esp-idf-v3/sdkconfig.defaults
```kconfig
CONFIG_IDF_TARGET="esp32s3"
CONFIG_ESPTOOLPY_FLASHSIZE_16MB=y
CONFIG_ESPTOOLPY_FLASHSIZE="16MB"
CONFIG_PARTITION_TABLE_CUSTOM=y
CONFIG_PARTITION_TABLE_CUSTOM_FILENAME="partitions.csv"
CONFIG_PARTITION_TABLE_FILENAME="partitions.csv"
CONFIG_ESP_DEFAULT_CPU_FREQ_MHZ_240=y
CONFIG_FREERTOS_HZ=1000
CONFIG_ESP_MAIN_TASK_STACK_SIZE=8192
CONFIG_SPIRAM=y
CONFIG_SPIRAM_MODE_OCT=y
CONFIG_SPIRAM_SPEED_80M=y
CONFIG_SPIRAM_IGNORE_NOTFOUND=y
CONFIG_SPIRAM_USE_CAPS_ALLOC=y
CONFIG_BOOTLOADER_APP_ROLLBACK_ENABLE=y
CONFIG_ESP_TASK_WDT_EN=y
CONFIG_ESP_TASK_WDT_INIT=y
CONFIG_ESP_TASK_WDT_TIMEOUT_S=10
CONFIG_ESP_TASK_WDT_CHECK_IDLE_TASK_CPU0=y
CONFIG_ESP_TASK_WDT_CHECK_IDLE_TASK_CPU1=y
CONFIG_ESP_COREDUMP_ENABLE_TO_FLASH=y
CONFIG_ESP_SYSTEM_PANIC_PRINT_REBOOT=y
CONFIG_COMPILER_OPTIMIZATION_SIZE=y
CONFIG_LOG_DEFAULT_LEVEL_INFO=y

CONFIG_ESP_CONSOLE_UART_DEFAULT=y
CONFIG_ESP_CONSOLE_UART_NUM=0
CONFIG_ESP_CONSOLE_UART_BAUDRATE=115200

CONFIG_LITTLEFS_MAX_PARTITIONS=1
CONFIG_LITTLEFS_CACHE_SIZE=512
CONFIG_LITTLEFS_USE_MTIME=y
CONFIG_UART_ISR_IN_IRAM=y
```
